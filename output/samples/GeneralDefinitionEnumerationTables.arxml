AUTOSAR XML (schema 00048)
package /AUTOSAR/DefaultEnumMappingTables
  288 x enumeration mapping table:
    AccessControlEnum: entrys=[{numerical-value=0, enumerator-value=MODELED}, {numerical-value=1, enumerator-value=CUSTOM}]
    AclScopeEnum
      entrys:
        numerical-value=0, enumerator-value=DEPENDANT
        numerical-value=1, enumerator-value=DESCENDANT
        numerical-value=2, enumerator-value=EXPLICIT
    AdditionalBindingTimeEnum
      entrys:
        numerical-value=0, enumerator-value=BLUEPRINT-DERIVATION-TIME
        numerical-value=1, enumerator-value=POST-BUILD
    AlignEnum
      entrys:
        numerical-value=0, enumerator-value=CENTER
        numerical-value=1, enumerator-value=JUSTIFY
        numerical-value=2, enumerator-value=LEFT
        numerical-value=3, enumerator-value=RIGHT
    ApiPrincipleEnum: entrys=[{numerical-value=0, enumerator-value=COMMON}, {numerical-value=1, enumerator-value=PER-EXECUTABLE}]
    AreaEnumNohref: entry{numerical-value=0, enumerator-value=NOHREF}
    AreaEnumShape
      entrys:
        numerical-value=0, enumerator-value=CIRCLE
        numerical-value=1, enumerator-value=DEFAULT
        numerical-value=2, enumerator-value=POLY
        numerical-value=3, enumerator-value=RECT
    ArgumentDirectionEnum
      entrys:
        numerical-value=0, enumerator-value=IN
        numerical-value=1, enumerator-value=INOUT
        numerical-value=2, enumerator-value=OUT
    ArraySizeHandlingEnum
      entrys:
        numerical-value=0, enumerator-value=ALL-INDICES-DIFFERENT-ARRAY-SIZE
        numerical-value=1, enumerator-value=ALL-INDICES-SAME-ARRAY-SIZE
        numerical-value=2, enumerator-value=INHERITED-FROM-ARRAY-ELEMENT-TYPE-SIZE
    ArraySizeSemanticsEnum: entrys=[{numerical-value=0, enumerator-value=FIXED-SIZE}, {numerical-value=1, enumerator-value=VARIABLE-SIZE}]
    AutoCollectEnum
      entrys:
        numerical-value=0, enumerator-value=REF-ALL
        numerical-value=1, enumerator-value=REF-NONE
        numerical-value=2, enumerator-value=REF-NON-STANDARD
    BindingTimeEnum
      entrys:
        numerical-value=0, enumerator-value=CODE-GENERATION-TIME
        numerical-value=1, enumerator-value=LINK-TIME
        numerical-value=2, enumerator-value=PRE-COMPILE-TIME
        numerical-value=3, enumerator-value=SYSTEM-DESIGN-TIME
    BswCallType
      entrys:
        numerical-value=0, enumerator-value=CALLBACK
        numerical-value=1, enumerator-value=INTERRUPT
        numerical-value=2, enumerator-value=REGULAR
        numerical-value=3, enumerator-value=SCHEDULED
        numerical-value=4, enumerator-value=CALLOUT
    BswEntryKindEnum: entrys=[{numerical-value=0, enumerator-value=ABSTRACT}, {numerical-value=1, enumerator-value=CONCRETE}]
    BswEntryRelationshipEnum: entry{numerical-value=0, enumerator-value=DERIVED-FROM}
    BswExecutionContext
      entrys:
        numerical-value=0, enumerator-value=HOOK
        numerical-value=1, enumerator-value=INTERRUPT-CAT-1
        numerical-value=2, enumerator-value=INTERRUPT-CAT-2
        numerical-value=3, enumerator-value=TASK
        numerical-value=4, enumerator-value=UNSPECIFIED
    BswInterruptCategory: entrys=[{numerical-value=0, enumerator-value=CAT-1}, {numerical-value=1, enumerator-value=CAT-2}]
    BuildTypeEnum
      entrys:
        numerical-value=0, enumerator-value=BUILD-TYPE-RELEASE
        numerical-value=1, enumerator-value=BUILD-TYPE-DEBUG
    ByteOrderEnum
      entrys:
        numerical-value=0, enumerator-value=big-endian
        numerical-value=1, enumerator-value=little-endian
        numerical-value=2, enumerator-value=opaque
    CSTransformerErrorReactionEnum
      entrys:
        numerical-value=0, enumerator-value=APPLICATION-ONLY
        numerical-value=1, enumerator-value=AUTONOMOUS
    CalprmAxisCategoryEnum
      entrys:
        numerical-value=0, enumerator-value=COM_AXIS
        numerical-value=1, enumerator-value=COM-AXIS
        numerical-value=2, enumerator-value=CURVE_AXIS
        numerical-value=3, enumerator-value=CURVE-AXIS
        numerical-value=4, enumerator-value=FIX_AXIS
        numerical-value=5, enumerator-value=FIX-AXIS
        numerical-value=6, enumerator-value=RES_AXIS
        numerical-value=7, enumerator-value=RES-AXIS
        numerical-value=8, enumerator-value=STD_AXIS
        numerical-value=9, enumerator-value=STD-AXIS
    CanAddressingModeType: entrys=[{numerical-value=0, enumerator-value=EXTENDED}, {numerical-value=1, enumerator-value=STANDARD}]
    CanFrameRxBehaviorEnum
      entrys:
        numerical-value=0, enumerator-value=ANY
        numerical-value=1, enumerator-value=CAN-20
        numerical-value=2, enumerator-value=CAN-FD
    CanFrameTxBehaviorEnum: entrys=[{numerical-value=0, enumerator-value=CAN-20}, {numerical-value=1, enumerator-value=CAN-FD}]
    CanTpAddressingFormatType
      entrys:
        numerical-value=0, enumerator-value=EXTENDED
        numerical-value=1, enumerator-value=MIXED
        numerical-value=2, enumerator-value=MIXED-29-BIT
        numerical-value=3, enumerator-value=NORMALFIXED
        numerical-value=4, enumerator-value=STANDARD
    CanTpChannelModeType
      entrys:
        numerical-value=0, enumerator-value=FULL-DUPLEX-MODE
        numerical-value=1, enumerator-value=HALF-DUPLEX-MODE
    ChapterEnumBreak: entrys=[{numerical-value=0, enumerator-value=BREAK}, {numerical-value=1, enumerator-value=NO-BREAK}]
    ClientCapabilityEnum: entrys=[{numerical-value=0, enumerator-value=WILL-CALL}, {numerical-value=1, enumerator-value=WONT-CALL}]
    CommandLineOptionKindEnum
      entrys:
        numerical-value=0, enumerator-value=COMMAND-LINE-SHORT-FORM
        numerical-value=1, enumerator-value=COMMAND-LINE-LONG-FORM
        numerical-value=2, enumerator-value=COMMAND-LINE-SIMPLE-FORM
    CommunicationDirectionType: entrys=[{numerical-value=0, enumerator-value=IN}, {numerical-value=1, enumerator-value=OUT}]
    ContainedIPduCollectionSemanticsEnum: entrys=[{numerical-value=0, enumerator-value=LAST-IS-BEST}, {numerical-value=1, enumerator-value=QUEUED}]
    ContainerIPduHeaderTypeEnum
      entrys:
        numerical-value=0, enumerator-value=LONG-HEADER
        numerical-value=1, enumerator-value=SHORT-HEADER
        numerical-value=2, enumerator-value=NO-HEADER
    ContainerIPduTriggerEnum
      entrys:
        numerical-value=0, enumerator-value=DEFAULT-TRIGGER
        numerical-value=1, enumerator-value=FIRST-CONTAINED-TRIGGER
    CouplingElementEnum
      entrys:
        numerical-value=0, enumerator-value=HUB
        numerical-value=1, enumerator-value=ROUTER
        numerical-value=2, enumerator-value=SWITCH
    CouplingPortRatePolicyActionEnum: entrys=[{numerical-value=0, enumerator-value=DROP-FRAME}, {numerical-value=1, enumerator-value=BLOCK-SOURCE}]
    CouplingPortRoleEnum
      entrys:
        numerical-value=0, enumerator-value=HOST-PORT
        numerical-value=1, enumerator-value=UP-LINK-PORT
        numerical-value=2, enumerator-value=STANDARD-PORT
    CryptoCertificateAlgorithmFamilyEnum: entrys=[{numerical-value=1, enumerator-value=RSA}, {numerical-value=2, enumerator-value=ECC}]
    CryptoCertificateFormatEnum: entrys=[{numerical-value=1, enumerator-value=X-509}, {numerical-value=2, enumerator-value=CVC}]
    CryptoServiceKeyGenerationEnum
      entrys:
        numerical-value=0, enumerator-value=KEY-DERIVATION
        numerical-value=1, enumerator-value=KEY-STORAGE
    CycleRepetitionType
      entrys:
        numerical-value=0, enumerator-value=CYCLE-REPETITION-1
        numerical-value=1, enumerator-value=CYCLE-REPETITION-10
        numerical-value=2, enumerator-value=CYCLE-REPETITION-16
        numerical-value=3, enumerator-value=CYCLE-REPETITION-2
        numerical-value=4, enumerator-value=CYCLE-REPETITION-20
        numerical-value=5, enumerator-value=CYCLE-REPETITION-32
        numerical-value=6, enumerator-value=CYCLE-REPETITION-4
        numerical-value=7, enumerator-value=CYCLE-REPETITION-40
        numerical-value=8, enumerator-value=CYCLE-REPETITION-5
        numerical-value=9, enumerator-value=CYCLE-REPETITION-50
        numerical-value=10, enumerator-value=CYCLE-REPETITION-64
        numerical-value=11, enumerator-value=CYCLE-REPETITION-8
    DataExchangePointKind
      entrys:
        numerical-value=0, enumerator-value=PRODUCER
        numerical-value=1, enumerator-value=CONSUMER
        numerical-value=2, enumerator-value=AGREED
    DataFilterTypeEnum
      entrys:
        numerical-value=0, enumerator-value=ALWAYS
        numerical-value=1, enumerator-value=MASKED-NEW-DIFFERS-MASKED-OLD
        numerical-value=2, enumerator-value=MASKED-NEW-DIFFERS-X
        numerical-value=3, enumerator-value=MASKED-NEW-EQUALS-X
        numerical-value=4, enumerator-value=NEVER
        numerical-value=5, enumerator-value=NEW-IS-OUTSIDE
        numerical-value=6, enumerator-value=NEW-IS-WITHIN
        numerical-value=7, enumerator-value=ONE-EVERY-N
    DataIdModeEnum
      entrys:
        numerical-value=0, enumerator-value=ALL-16-BIT
        numerical-value=1, enumerator-value=ALTERNATING-8-BIT
        numerical-value=2, enumerator-value=LOWER-12-BIT
        numerical-value=3, enumerator-value=LOWER-8-BIT
    DataLimitKindEnum
      entrys:
        numerical-value=0, enumerator-value=MAX
        numerical-value=1, enumerator-value=MIN
        numerical-value=2, enumerator-value=NONE
    DataTransformationErrorHandlingEnum
      entrys:
        numerical-value=0, enumerator-value=NO-TRANSFORMER-ERROR-HANDLING
        numerical-value=1, enumerator-value=TRANSFORMER-ERROR-HANDLING
    DataTransformationKindEnum
      entrys:
        numerical-value=0, enumerator-value=ASYMMETRIC-FROM-BYTE-ARRAY
        numerical-value=1, enumerator-value=ASYMMETRIC-TO-BYTE-ARRAY
        numerical-value=2, enumerator-value=SYMMETRIC
    DataTransformationStatusForwardingEnum
      entrys:
        numerical-value=0, enumerator-value=NO-TRANSFORMER-STATUS-FORWARDING
        numerical-value=1, enumerator-value=TRANSFORMER-STATUS-FORWARDING
    DataTypePolicyEnum
      entrys:
        numerical-value=0, enumerator-value=LEGACY
        numerical-value=1, enumerator-value=NETWORK-REPRESENTATION-FROM-COM-SPEC
        numerical-value=2, enumerator-value=OVERRIDE
        numerical-value=3, enumerator-value=PORT-INTERFACE-DEFINITION
        numerical-value=4, enumerator-value=TRANSFORMING-I-SIGNAL
    DefaultValueApplicationStrategyEnum
      entrys:
        numerical-value=0, enumerator-value=NO-DEFAULT
        numerical-value=1, enumerator-value=DEFAULT-IF-REVISION-UPDATE
        numerical-value=2, enumerator-value=DEFAULT-IF-UNDEFINED
    DependencyUsageEnum
      entrys:
        numerical-value=0, enumerator-value=BUILD
        numerical-value=1, enumerator-value=CODEGENERATION
        numerical-value=2, enumerator-value=COMPILE
        numerical-value=3, enumerator-value=EXECUTE
        numerical-value=4, enumerator-value=LINK
    DiagPduType
      entrys:
        numerical-value=0, enumerator-value=DIAG-REQUEST
        numerical-value=1, enumerator-value=DIAG-RESPONSE
    DiagnosticAccessPermissionValidityEnum
      entrys:
        numerical-value=0, enumerator-value=ACCES-PERRMISSION-SERVICE-CLASS
        numerical-value=1, enumerator-value=ACCESS-PERMISSION-INSTANCE-OVERRIDES-CLASS
        numerical-value=2, enumerator-value=ACCESS-PERMISSION-SERVICE-CLASS
        numerical-value=3, enumerator-value=ACCESS-PERMISSION-SERVICE-INSTANCE
    DiagnosticAudienceEnum
      entrys:
        numerical-value=0, enumerator-value=AFTERMAKET
        numerical-value=1, enumerator-value=AFTERMARKET
        numerical-value=2, enumerator-value=AFTER-SALES
        numerical-value=3, enumerator-value=DEVELOPMENT
        numerical-value=4, enumerator-value=MANUFACTURING
        numerical-value=5, enumerator-value=SUPPLIER
    DiagnosticClearDtcLimitationEnum
      entrys:
        numerical-value=0, enumerator-value=ALL-SUPPORTED-DTCS
        numerical-value=1, enumerator-value=CLEAR-ALL-DTCS
    DiagnosticClearEventBehaviorEnum
      entrys:
        numerical-value=0, enumerator-value=NO-STATUS-BYTE-CHANGE
        numerical-value=1, enumerator-value=ONLY-THIS-CYCLE-AND-READINESS
    DiagnosticCompareTypeEnum
      entrys:
        numerical-value=0, enumerator-value=IS-EQUAL
        numerical-value=1, enumerator-value=IS-NOT-EQUAL
        numerical-value=2, enumerator-value=IS-LESS-THAN
        numerical-value=3, enumerator-value=IS-LESS-OR-EQUAL
        numerical-value=4, enumerator-value=IS-GREATER-THAN
        numerical-value=5, enumerator-value=IS-GREATER-OR-EQUAL
    DiagnosticConnectedIndicatorBehaviorEnum
      entrys:
        numerical-value=0, enumerator-value=BLINK-MODE
        numerical-value=1, enumerator-value=BLINK-OR-CONTINUOUS-ON-MODE
        numerical-value=2, enumerator-value=CONTINUOUS-ON-MODE
        numerical-value=3, enumerator-value=FAST-FLASHING-MODE
        numerical-value=4, enumerator-value=SLOW-FLASHING-MODE
    DiagnosticDataCaptureEnum
      entrys:
        numerical-value=0, enumerator-value=CAPTURE-ASYNCHRONOUSLY-TO-REPORTING
        numerical-value=1, enumerator-value=CAPTURE-SYNCHRONOUSLY-TO-REPORTING
    DiagnosticDebounceBehaviorEnum: entrys=[{numerical-value=0, enumerator-value=FREEZE}, {numerical-value=1, enumerator-value=RESET}]
    DiagnosticDenominatorConditionEnum
      entrys:
        numerical-value=0, enumerator-value=COLDSTART
        numerical-value=1, enumerator-value=EVAP
        numerical-value=2, enumerator-value=-500-MILES
        numerical-value=3, enumerator-value=INDIVIDUAL
        numerical-value=4, enumerator-value=OBD
    DiagnosticDynamicallyDefineDataIdentifierSubfunctionEnum
      entrys:
        numerical-value=0, enumerator-value=CLEAR-DYNAMICALLY-DEFINE-DATA-IDENTIFIER
        numerical-value=1, enumerator-value=DEFINE-BY-IDENTIFIER
        numerical-value=2, enumerator-value=DEFINE-BY-MEMORY-ADDRESS
    DiagnosticEventClearAllowedEnum
      entrys:
        numerical-value=0, enumerator-value=ALWAYS
        numerical-value=1, enumerator-value=NEVER
        numerical-value=2, enumerator-value=REQUIRES-CALLBACK-EXECUTION
    DiagnosticEventDisplacementStrategyEnum
      entrys:
        numerical-value=0, enumerator-value=FULL
        numerical-value=1, enumerator-value=NONE
        numerical-value=2, enumerator-value=PRIO-OCC
    DiagnosticEventKindEnum: entrys=[{numerical-value=0, enumerator-value=BSW}, {numerical-value=1, enumerator-value=SWC}]
    DiagnosticEventWindowTimeEnum
      entrys:
        numerical-value=0, enumerator-value=EVENT-WINDOW-CURRENT-AND-FOLLOWING-CYCLE
        numerical-value=1, enumerator-value=EVENT-WINDOW-CURRENT-CYCLE
        numerical-value=2, enumerator-value=EVENT-WINDOW-INFINITE
    DiagnosticHandleDDDIConfigurationEnum: entrys=[{numerical-value=0, enumerator-value=NON-VOLATILE}, {numerical-value=1, enumerator-value=VOLATILE}]
    DiagnosticIndicatorTypeEnum
      entrys:
        numerical-value=0, enumerator-value=AMBER-WARNING
        numerical-value=1, enumerator-value=MALFUNCTION
        numerical-value=2, enumerator-value=PROTECT-LAMP
        numerical-value=3, enumerator-value=RED-STOP-LAMP
        numerical-value=4, enumerator-value=WARNING
    DiagnosticInhibitionMaskEnum
      entrys:
        numerical-value=0, enumerator-value=LAST-FAILED
        numerical-value=1, enumerator-value=NOT-TESTED
        numerical-value=2, enumerator-value=TESTED-AND-FAILED
        numerical-value=3, enumerator-value=TESTED
    DiagnosticInitialEventStatusEnum
      entrys:
        numerical-value=0, enumerator-value=RETURN-ON-EVENT-CLEARED
        numerical-value=1, enumerator-value=RETURN-ON-EVENT-STOPPED
    DiagnosticJumpToBootLoaderEnum
      entrys:
        numerical-value=0, enumerator-value=NO-BOOT
        numerical-value=1, enumerator-value=OEM-BOOT
        numerical-value=2, enumerator-value=SYSTEM-SUPPLIER-BOOT
        numerical-value=3, enumerator-value=OEM-BOOT-RESP-APP
        numerical-value=4, enumerator-value=SYSTEM-SUPPLIER-BOOT-RESP-APP
    DiagnosticLogicalOperatorEnum: entrys=[{numerical-value=0, enumerator-value=LOGICAL-AND}, {numerical-value=1, enumerator-value=LOGICAL-OR}]
    DiagnosticMemoryEntryStorageTriggerEnum
      entrys:
        numerical-value=0, enumerator-value=CONFIRMED
        numerical-value=1, enumerator-value=FDC-THRESHOLD
        numerical-value=2, enumerator-value=PENDING
        numerical-value=3, enumerator-value=TEST-FAILED
    DiagnosticMonitorUpdateKindEnum: entrys=[{numerical-value=0, enumerator-value=ALWAYS}, {numerical-value=1, enumerator-value=STEADY}]
    DiagnosticObdSupportEnum
      entrys:
        numerical-value=0, enumerator-value=MASTER-ECU
        numerical-value=1, enumerator-value=NO-OBD-SUPPORT
        numerical-value=2, enumerator-value=PRIMARY-ECU
        numerical-value=3, enumerator-value=SECONDARY-ECU
    DiagnosticOccurrenceCounterProcessingEnum
      entrys:
        numerical-value=0, enumerator-value=CONFIRMED-DTC-BIT
        numerical-value=1, enumerator-value=TEST-FAILED-BIT
    DiagnosticOperationCycleTypeEnum
      entrys:
        numerical-value=0, enumerator-value=IGNITION
        numerical-value=1, enumerator-value=OBD-DRIVING-CYCLE
        numerical-value=2, enumerator-value=OTHER
        numerical-value=3, enumerator-value=POWER
        numerical-value=4, enumerator-value=TIME
        numerical-value=5, enumerator-value=WARMUP
    DiagnosticPeriodicRateCategoryEnum
      entrys:
        numerical-value=0, enumerator-value=PERIODIC-RATE-FAST
        numerical-value=1, enumerator-value=PERIODIC-RATE-MEDIUM
        numerical-value=2, enumerator-value=PERIODIC-RATE-SLOW
    DiagnosticProcessingStyleEnum
      entrys:
        numerical-value=0, enumerator-value=PROCESSING-STYLE-ASYNCHRONOUS
        numerical-value=1, enumerator-value=PROCESSING-STYLE-ASYNCHRONOUS-WITH-ERROR
        numerical-value=2, enumerator-value=PROCESSING-STYLE-SYNCHRONOUS
    DiagnosticRecordTriggerEnum
      entrys:
        numerical-value=0, enumerator-value=CONFIRMED
        numerical-value=1, enumerator-value=FDC-THRESHOLD
        numerical-value=2, enumerator-value=PENDING
        numerical-value=3, enumerator-value=TEST-FAILED
        numerical-value=4, enumerator-value=CUSTOM
    DiagnosticResponseOnEventActionEnum
      entrys:
        numerical-value=0, enumerator-value=STOP
        numerical-value=1, enumerator-value=START
        numerical-value=2, enumerator-value=CLEAR
        numerical-value=3, enumerator-value=REPORT
    DiagnosticResponseToEcuResetEnum
      entrys:
        numerical-value=0, enumerator-value=RESPOND-AFTER-RESET
        numerical-value=1, enumerator-value=RESPOND-BEFORE-RESET
    DiagnosticRoutineTypeEnum: entrys=[{numerical-value=0, enumerator-value=ASYNCHRONOUS}, {numerical-value=1, enumerator-value=SYNCHRONOUS}]
    DiagnosticServiceRequestCallbackTypeEnum
      entrys:
        numerical-value=0, enumerator-value=REQUEST-CALLBACK-TYPE-MANUFACTURER
        numerical-value=1, enumerator-value=REQUEST-CALLBACK-TYPE-SUPPLIER
    DiagnosticSignificanceEnum: entrys=[{numerical-value=0, enumerator-value=FAULT}, {numerical-value=1, enumerator-value=OCCURENCE}]
    DiagnosticStatusBitHandlingTestFailedSinceLastClearEnum
      entrys:
        numerical-value=0, enumerator-value=STATUS-BIT-AGING-AND-DISPLACEMENT
        numerical-value=1, enumerator-value=STATUS-BIT-NORMAL
    DiagnosticStoreEventSupportEnum
      entrys:
        numerical-value=0, enumerator-value=NO-STORE-EVENT
        numerical-value=1, enumerator-value=STORE-EVENT
        numerical-value=2, enumerator-value=ALL
    DiagnosticTestResultUpdateEnum: entrys=[{numerical-value=0, enumerator-value=ALWAYS}, {numerical-value=1, enumerator-value=STEADY}]
    DiagnosticTroubleCodeJ1939DtcKindEnum: entrys=[{numerical-value=0, enumerator-value=SERVICE-ONLY}, {numerical-value=1, enumerator-value=STANDARD}]
    DiagnosticTypeOfDtcSupportedEnum
      entrys:
        numerical-value=0, enumerator-value=ISO-11992--4
        numerical-value=1, enumerator-value=ISO-14229--1
        numerical-value=2, enumerator-value=ISO-15031--6
        numerical-value=3, enumerator-value=SAE-J-1939--73
        numerical-value=4, enumerator-value=SAE-J-2012--DA
    DiagnosticTypeOfFreezeFrameRecordNumerationEnum: entrys=[{numerical-value=0, enumerator-value=CALCULATED}, {numerical-value=1, enumerator-value=CONFIGURED}]
    DiagnosticUdsSeverityEnum
      entrys:
        numerical-value=0, enumerator-value=CHECK-AT-NEXT-HALT
        numerical-value=1, enumerator-value=IMMEDIATELY
        numerical-value=2, enumerator-value=MAINTENANCE-ONLY
        numerical-value=3, enumerator-value=NO-SEVERITY
    DiagnosticValueAccessEnum
      entrys:
        numerical-value=0, enumerator-value=READ-ONLY
        numerical-value=1, enumerator-value=READ-WRITE
        numerical-value=2, enumerator-value=WRITE-ONLY
    DiagnosticWwhObdDtcClassEnum
      entrys:
        numerical-value=0, enumerator-value=DEM-DTC-WWH-OBD-CLASS-A
        numerical-value=1, enumerator-value=DEM-DTC-WWH-OBD-CLASS-B-1
        numerical-value=2, enumerator-value=DEM-DTC-WWH-OBD-CLASS-B-2
        numerical-value=3, enumerator-value=DEM-DTC-WWH-OBD-CLASS-C
        numerical-value=4, enumerator-value=DEM-DTC-WWH-OBD-CLASS-NO-INFORMATION
    DiscoveryTechnologyEnum
      entrys:
        numerical-value=0, enumerator-value=BONJOUR
        numerical-value=1, enumerator-value=DLNA
        numerical-value=2, enumerator-value=SLP
        numerical-value=3, enumerator-value=SOMEIP
        numerical-value=4, enumerator-value=SSDP
    DisplayPresentationEnum
      entrys:
        numerical-value=0, enumerator-value=PRESENTATION-CONTINUOUS
        numerical-value=1, enumerator-value=PRESENTATION-DISCRETE
    DoIpEntityRoleEnum
      entrys:
        numerical-value=0, enumerator-value=EDGE-NODE
        numerical-value=1, enumerator-value=GATEWAY
        numerical-value=2, enumerator-value=NODE
    DtcFormatTypeEnum
      entrys:
        numerical-value=0, enumerator-value=J-1939
        numerical-value=1, enumerator-value=OBD
        numerical-value=2, enumerator-value=UDS
    DtcKindEnum
      entrys:
        numerical-value=0, enumerator-value=EMISSION-RELATED-DTC
        numerical-value=1, enumerator-value=NON-EMMISSION-RELATED-DTC
    EEnum
      entrys:
        numerical-value=0, enumerator-value=BOLD
        numerical-value=1, enumerator-value=BOLDITALIC
        numerical-value=2, enumerator-value=ITALIC
        numerical-value=3, enumerator-value=PLAIN
    EEnumFont: entrys=[{numerical-value=0, enumerator-value=DEFAULT}, {numerical-value=1, enumerator-value=MONO}]
    EcucAffectionEnum
      entrys:
        numerical-value=0, enumerator-value=LT-AFFECTS-PB
        numerical-value=1, enumerator-value=NO-AFFECT
        numerical-value=2, enumerator-value=PC-AFFECTS-LT
        numerical-value=3, enumerator-value=PC-AFFECTS-LT-AND-PB
        numerical-value=4, enumerator-value=PC-AFFECTS-PB
    EcucConfigurationClassEnum
      entrys:
        numerical-value=0, enumerator-value=LINK
        numerical-value=1, enumerator-value=POST-BUILD
        numerical-value=2, enumerator-value=PRE-COMPILE
        numerical-value=3, enumerator-value=PUBLISHED-INFORMATION
    EcucConfigurationVariantEnum
      entrys:
        numerical-value=0, enumerator-value=PRECONFIGURED-CONFIGURATION
        numerical-value=1, enumerator-value=RECOMMENDED-CONFIGURATION
        numerical-value=2, enumerator-value=VARIANT-LINK-TIME
        numerical-value=3, enumerator-value=VARIANT-POST-BUILD
        numerical-value=4, enumerator-value=VARIANT-POST-BUILD-LOADABLE
        numerical-value=5, enumerator-value=VARIANT-POST-BUILD-SELECTABLE
        numerical-value=6, enumerator-value=VARIANT-PRE-COMPILE
    EcucDestinationUriNestingContractEnum
      entrys:
        numerical-value=0, enumerator-value=LEAF-OF-TARGET-CONTAINER
        numerical-value=1, enumerator-value=TARGET-CONTAINER
        numerical-value=2, enumerator-value=VERTEX-OF-TARGET-CONTAINER
    EcucScopeEnum: entrys=[{numerical-value=0, enumerator-value=ECU}, {numerical-value=1, enumerator-value=LOCAL}]
    EndToEndProfileBehaviorEnum: entrys=[{numerical-value=0, enumerator-value=PRE--R-4--2}, {numerical-value=1, enumerator-value=R-4--2}]
    EnvironmentCaptureToReportingEnum
      entrys:
        numerical-value=0, enumerator-value=CAPTURE-ASYNCHRONOUS-TO-REPORTING
        numerical-value=1, enumerator-value=CAPTURE-SYNCHRONOUS-TO-REPORTING
    EthGlobalTimeMessageFormatEnum
      entrys:
        numerical-value=0, enumerator-value=IEEE802-1AS
        numerical-value=1, enumerator-value=IEEE802-1AS-AUTOSAR
    EthernetConnectionNegotiationEnum
      entrys:
        numerical-value=0, enumerator-value=AUTO
        numerical-value=1, enumerator-value=MASTER
        numerical-value=2, enumerator-value=SLAVE
    EthernetCouplingPortSchedulerEnum
      entrys:
        numerical-value=0, enumerator-value=DEFICIT-ROUND-ROBIN
        numerical-value=1, enumerator-value=STRICT-PRIORITY
        numerical-value=2, enumerator-value=WEIGHTED-ROUND-ROBIN
    EthernetMacLayerTypeEnum
      entrys:
        numerical-value=0, enumerator-value=X-MII
        numerical-value=1, enumerator-value=XG-MII
        numerical-value=2, enumerator-value=XXG-MII
    EthernetPhysicalLayerTypeEnum
      entrys:
        numerical-value=0, enumerator-value=BASE-T
        numerical-value=1, enumerator-value=BROAD-R-REACH
        numerical-value=2, enumerator-value=RTPGE
        numerical-value=3, enumerator-value=X-MII
        numerical-value=4, enumerator-value=X-MMI
        numerical-value=5, enumerator-value=100BASE-TX
        numerical-value=6, enumerator-value=1000BASE-T
        numerical-value=7, enumerator-value=100BASE-T1
        numerical-value=8, enumerator-value=1000BASE-T1
        numerical-value=9, enumerator-value=IEEE802-11P
    EthernetSwitchVlanEgressTaggingEnum
      entrys:
        numerical-value=0, enumerator-value=NOT-SENT
        numerical-value=1, enumerator-value=SENT-TAGGED
        numerical-value=2, enumerator-value=SENT-UNTAGGED
    EthernetSwitchVlanIngressTagEnum
      entrys:
        numerical-value=0, enumerator-value=FORWARD-AS-IS
        numerical-value=1, enumerator-value=DROP-UNTAGGED
    EventAcceptanceStatusEnum
      entrys:
        numerical-value=0, enumerator-value=EVENT-ACCEPTANCE-DISABLED
        numerical-value=1, enumerator-value=EVENT-ACCEPTANCE-ENABLED
    EventGroupControlTypeEnum
      entrys:
        numerical-value=0, enumerator-value=ACTIVATION-AND-TRIGGER-UNICAST
        numerical-value=1, enumerator-value=ACTIVATION-MULTICAST
        numerical-value=2, enumerator-value=ACTIVATION-UNICAST
        numerical-value=3, enumerator-value=TRIGGER-UNICAST
    EventOccurrenceKindEnum
      entrys:
        numerical-value=0, enumerator-value=MULTIPLE-OCCURRENCES
        numerical-value=1, enumerator-value=SINGLE-OCCURRENCE
    ExecutionOrderConstraintTypeEnum
      entrys:
        numerical-value=0, enumerator-value=HIERARCHICAL-EOC
        numerical-value=1, enumerator-value=ORDINARY-EOC
        numerical-value=2, enumerator-value=REPETITIVE-EOC
    ExecutionStateReportingBehaviorEnum
      entrys:
        numerical-value=0, enumerator-value=REPORTS-EXECUTION-STATE
        numerical-value=1, enumerator-value=DOES-NOT-REPORT-EXECUTION-STATE
    ExecutionTimeTypeEnum: entrys=[{numerical-value=0, enumerator-value=GROSS}, {numerical-value=1, enumerator-value=NET}]
    FMFeatureSelectionState
      entrys:
        numerical-value=0, enumerator-value=DESELECTED
        numerical-value=1, enumerator-value=SELECTED
        numerical-value=2, enumerator-value=UNDECIDED
    FieldAccessEnum
      entrys:
        numerical-value=0, enumerator-value=GETTER
        numerical-value=1, enumerator-value=SETTER
        numerical-value=2, enumerator-value=GETTER-SETTER
    FilterDebouncingEnum
      entrys:
        numerical-value=0, enumerator-value=DEBOUNCE-DATA
        numerical-value=1, enumerator-value=RAW-DATA
        numerical-value=2, enumerator-value=WAIT-TIME-DATE
    FlexrayChannelName: entrys=[{numerical-value=0, enumerator-value=CHANNEL-A}, {numerical-value=1, enumerator-value=CHANNEL-B}]
    FlexrayNmScheduleVariant
      entrys:
        numerical-value=0, enumerator-value=SCHEDULE-VARIANT-1
        numerical-value=1, enumerator-value=SCHEDULE-VARIANT-2
        numerical-value=2, enumerator-value=SCHEDULE-VARIANT-3
        numerical-value=3, enumerator-value=SCHEDULE-VARIANT-4
        numerical-value=4, enumerator-value=SCHEDULE-VARIANT-5
        numerical-value=5, enumerator-value=SCHEDULE-VARIANT-6
        numerical-value=6, enumerator-value=SCHEDULE-VARIANT-7
    FloatEnum: entrys=[{numerical-value=0, enumerator-value=FLOAT}, {numerical-value=1, enumerator-value=NO-FLOAT}]
    FrArTpAckType
      entrys:
        numerical-value=0, enumerator-value=ACK-WITHOUT-RT
        numerical-value=1, enumerator-value=ACK-WITH-RT
        numerical-value=2, enumerator-value=NO-ACK
    FrameEnum
      entrys:
        numerical-value=0, enumerator-value=ALL
        numerical-value=1, enumerator-value=BOTTOM
        numerical-value=2, enumerator-value=NONE
        numerical-value=3, enumerator-value=SIDES
        numerical-value=4, enumerator-value=TOP
        numerical-value=5, enumerator-value=TOPBOT
    FullBindingTimeEnum
      entrys:
        numerical-value=0, enumerator-value=BLUEPRINT-DERIVATION-TIME
        numerical-value=1, enumerator-value=SYSTEM-DESIGN-TIME
        numerical-value=2, enumerator-value=CODE-GENERATION-TIME
        numerical-value=3, enumerator-value=PRE-COMPILE-TIME
        numerical-value=4, enumerator-value=LINK-TIME
        numerical-value=5, enumerator-value=POST-BUILD
    GlobalTimeCrcSupportEnum
      entrys:
        numerical-value=0, enumerator-value=CRC-NOT-SUPPORTED
        numerical-value=1, enumerator-value=CRC-SUPPORTED
    GlobalTimeCrcValidationEnum
      entrys:
        numerical-value=0, enumerator-value=CRC-IGNORED
        numerical-value=1, enumerator-value=CRC-NOT-VALIDATED
        numerical-value=2, enumerator-value=CRC-VALIDATED
        numerical-value=3, enumerator-value=CRC-OPTIONAL
    GraphicFitEnum
      entrys:
        numerical-value=0, enumerator-value=AS-IS
        numerical-value=1, enumerator-value=FIT-TO-PAGE
        numerical-value=2, enumerator-value=FIT-TO-TEXT
        numerical-value=3, enumerator-value=LIMIT-TO-PAGE
        numerical-value=4, enumerator-value=LIMIT-TO-TEXT
        numerical-value=5, enumerator-value=ROTATE-180
        numerical-value=6, enumerator-value=ROTATE-180-LIMIT-TO-TEXT
        numerical-value=7, enumerator-value=ROTATE-90-CCW
        numerical-value=8, enumerator-value=ROTATE-90-CCW-FIT-TO-TEXT
        numerical-value=9, enumerator-value=ROTATE-90-CCW-LIMIT-TO-TEXT
        numerical-value=10, enumerator-value=ROTATE-90-CW
        numerical-value=11, enumerator-value=ROTATE-90-CW-FIT-TO-TEXT
        numerical-value=12, enumerator-value=ROTATE-90-CW-LIMIT-TO-TEXT
    GraphicNotationEnum
      entrys:
        numerical-value=0, enumerator-value=BMP
        numerical-value=1, enumerator-value=EPS
        numerical-value=2, enumerator-value=GIF
        numerical-value=3, enumerator-value=JPG
        numerical-value=4, enumerator-value=PDF
        numerical-value=5, enumerator-value=PNG
        numerical-value=6, enumerator-value=SVG
        numerical-value=7, enumerator-value=TIFF
    HCConditionEnum: entrys=[{numerical-value=0, enumerator-value=EQUAL}, {numerical-value=1, enumerator-value=NOT-EQUAL}]
    HCSupervisionConditionTypeEnum
      entrys:
        numerical-value=0, enumerator-value=IS-OK
        numerical-value=1, enumerator-value=IS-FAILED
        numerical-value=2, enumerator-value=IS-EXPIRED
        numerical-value=3, enumerator-value=IS-STOPPED
    HandleInvalidEnum
      entrys:
        numerical-value=0, enumerator-value=DONT-INVALIDATE
        numerical-value=1, enumerator-value=EXTERNAL-REPLACEMENT
        numerical-value=2, enumerator-value=KEEP
        numerical-value=3, enumerator-value=REPLACE
    HandleOutOfRangeEnum
      entrys:
        numerical-value=0, enumerator-value=DEFAULT
        numerical-value=1, enumerator-value=EXTERNAL-REPLACEMENT
        numerical-value=2, enumerator-value=IGNORE
        numerical-value=3, enumerator-value=INVALID
        numerical-value=4, enumerator-value=NONE
        numerical-value=5, enumerator-value=SATURATE
    HandleOutOfRangeStatusEnum: entrys=[{numerical-value=0, enumerator-value=INDICATE}, {numerical-value=1, enumerator-value=SILENT}]
    HandleTerminationAndRestartEnum
      entrys:
        numerical-value=0, enumerator-value=CAN-BE-TERMINATED
        numerical-value=1, enumerator-value=CAN-BE-TERMINATED-AND-RESTARTED
        numerical-value=2, enumerator-value=NO-SUPPORT
    HandleTimeoutEnum
      entrys:
        numerical-value=0, enumerator-value=NONE
        numerical-value=1, enumerator-value=REPLACE
        numerical-value=2, enumerator-value=REPLACE-BY-TIMEOUT-SUBSTITUTION-VALUE
    HttpAcceptEncodingEnum: entrys=[{numerical-value=0, enumerator-value=GZIP}, {numerical-value=1, enumerator-value=DEFLATE}]
    IPduSignalProcessingEnum: entrys=[{numerical-value=0, enumerator-value=DEFERRED}, {numerical-value=1, enumerator-value=IMMEDIATE}]
    IPsecDpdActionEnum
      entrys:
        numerical-value=0, enumerator-value=CLEAR
        numerical-value=1, enumerator-value=TRAP
        numerical-value=2, enumerator-value=RESTART
    IPsecHeaderTypeEnum
      entrys:
        numerical-value=0, enumerator-value=AH
        numerical-value=1, enumerator-value=ESP
        numerical-value=2, enumerator-value=NONE
    IPsecIpProtocolEnum
      entrys:
        numerical-value=0, enumerator-value=UDP
        numerical-value=1, enumerator-value=TCP
        numerical-value=2, enumerator-value=ICMP
        numerical-value=3, enumerator-value=ANY
    IPsecModeEnum: entrys=[{numerical-value=0, enumerator-value=TUNNEL}, {numerical-value=1, enumerator-value=TRANSPORT}]
    IPsecPolicyEnum
      entrys:
        numerical-value=1, enumerator-value=IPSEC
        numerical-value=2, enumerator-value=PASSTHROUGH
        numerical-value=3, enumerator-value=DROP
        numerical-value=4, enumerator-value=REJECT
    ISignalTypeEnum: entrys=[{numerical-value=0, enumerator-value=ARRAY}, {numerical-value=1, enumerator-value=PRIMITIVE}]
    IkeAuthenticationMethodEnum: entrys=[{numerical-value=1, enumerator-value=PSK}, {numerical-value=2, enumerator-value=DSA}]
    IntervalTypeEnum
      entrys:
        numerical-value=0, enumerator-value=CLOSED
        numerical-value=1, enumerator-value=INFINITE
        numerical-value=2, enumerator-value=OPEN
    IpAddressKeepEnum: entrys=[{numerical-value=0, enumerator-value=FORGET}, {numerical-value=1, enumerator-value=STORE-PERSISTENTLY}]
    Ipv4AddressSourceEnum
      entrys:
        numerical-value=0, enumerator-value=AUTO-IP
        numerical-value=1, enumerator-value=AUTO-IPDHCPV-4
        numerical-value=2, enumerator-value=AUTO-IP--DOIP
        numerical-value=3, enumerator-value=DHCPV-4
        numerical-value=4, enumerator-value=FIXED
    Ipv6AddressSourceEnum
      entrys:
        numerical-value=0, enumerator-value=DHCPV-6
        numerical-value=1, enumerator-value=FIXED
        numerical-value=2, enumerator-value=LINK-LOCAL
        numerical-value=3, enumerator-value=LINK-LOCAL--DOIP
        numerical-value=4, enumerator-value=ROUTER-ADVERTISEMENT
    ItemLabelPosEnum
      entrys:
        numerical-value=0, enumerator-value=NEWLINE
        numerical-value=1, enumerator-value=NEWLINE-IF-NECESSARY
        numerical-value=2, enumerator-value=NO-NEWLINE
    KeepWithPreviousEnum: entrys=[{numerical-value=0, enumerator-value=KEEP}, {numerical-value=1, enumerator-value=NO-KEEP}]
    KeyUsageRestrictionEnum
      entrys:
        numerical-value=0, enumerator-value=GENERATE
        numerical-value=1, enumerator-value=GENERATE-AND-VERIFY
        numerical-value=2, enumerator-value=VERIFY
    LEnum
      entrys:
        numerical-value=0, enumerator-value=AA
        numerical-value=1, enumerator-value=AB
        numerical-value=2, enumerator-value=AF
        numerical-value=3, enumerator-value=AM
        numerical-value=4, enumerator-value=AR
        numerical-value=5, enumerator-value=AS
        numerical-value=6, enumerator-value=AY
        numerical-value=7, enumerator-value=AZ
        numerical-value=8, enumerator-value=BA
        numerical-value=9, enumerator-value=BE
        numerical-value=10, enumerator-value=BG
        numerical-value=11, enumerator-value=BH
        numerical-value=12, enumerator-value=BI
        numerical-value=13, enumerator-value=BN
        numerical-value=14, enumerator-value=BO
        numerical-value=15, enumerator-value=BR
        numerical-value=16, enumerator-value=CA
        numerical-value=17, enumerator-value=CO
        numerical-value=18, enumerator-value=CS
        numerical-value=19, enumerator-value=CY
        numerical-value=20, enumerator-value=DA
        numerical-value=21, enumerator-value=DE
        numerical-value=22, enumerator-value=DZ
        numerical-value=23, enumerator-value=EL
        numerical-value=24, enumerator-value=EN
        numerical-value=25, enumerator-value=EO
        numerical-value=26, enumerator-value=ES
        numerical-value=27, enumerator-value=ET
        numerical-value=28, enumerator-value=EU
        numerical-value=29, enumerator-value=FA
        numerical-value=30, enumerator-value=FI
        numerical-value=31, enumerator-value=FJ
        numerical-value=32, enumerator-value=FO
        numerical-value=33, enumerator-value=FOR-ALL
        numerical-value=34, enumerator-value=FR
        numerical-value=35, enumerator-value=FY
        numerical-value=36, enumerator-value=GA
        numerical-value=37, enumerator-value=GD
        numerical-value=38, enumerator-value=GL
        numerical-value=39, enumerator-value=GN
        numerical-value=40, enumerator-value=GU
        numerical-value=41, enumerator-value=HA
        numerical-value=42, enumerator-value=HI
        numerical-value=43, enumerator-value=HR
        numerical-value=44, enumerator-value=HU
        numerical-value=45, enumerator-value=HY
        numerical-value=46, enumerator-value=IA
        numerical-value=47, enumerator-value=IE
        numerical-value=48, enumerator-value=IK
        numerical-value=49, enumerator-value=IN
        numerical-value=50, enumerator-value=IS
        numerical-value=51, enumerator-value=IT
        numerical-value=52, enumerator-value=IW
        numerical-value=53, enumerator-value=JA
        numerical-value=54, enumerator-value=JI
        numerical-value=55, enumerator-value=JW
        numerical-value=56, enumerator-value=KA
        numerical-value=57, enumerator-value=KK
        numerical-value=58, enumerator-value=KL
        numerical-value=59, enumerator-value=KM
        numerical-value=60, enumerator-value=KN
        numerical-value=61, enumerator-value=KO
        numerical-value=62, enumerator-value=KS
        numerical-value=63, enumerator-value=KU
        numerical-value=64, enumerator-value=KY
        numerical-value=65, enumerator-value=LA
        numerical-value=66, enumerator-value=LN
        numerical-value=67, enumerator-value=LO
        numerical-value=68, enumerator-value=LT
        numerical-value=69, enumerator-value=LV
        numerical-value=70, enumerator-value=MG
        numerical-value=71, enumerator-value=MI
        numerical-value=72, enumerator-value=MK
        numerical-value=73, enumerator-value=ML
        numerical-value=74, enumerator-value=MN
        numerical-value=75, enumerator-value=MO
        numerical-value=76, enumerator-value=MR
        numerical-value=77, enumerator-value=MS
        numerical-value=78, enumerator-value=MT
        numerical-value=79, enumerator-value=MY
        numerical-value=80, enumerator-value=NA
        numerical-value=81, enumerator-value=NE
        numerical-value=82, enumerator-value=NL
        numerical-value=83, enumerator-value=NO
        numerical-value=84, enumerator-value=OC
        numerical-value=85, enumerator-value=OM
        numerical-value=86, enumerator-value=OR
        numerical-value=87, enumerator-value=PA
        numerical-value=88, enumerator-value=PL
        numerical-value=89, enumerator-value=PS
        numerical-value=90, enumerator-value=PT
        numerical-value=91, enumerator-value=QU
        numerical-value=92, enumerator-value=RM
        numerical-value=93, enumerator-value=RN
        numerical-value=94, enumerator-value=RO
        numerical-value=95, enumerator-value=RU
        numerical-value=96, enumerator-value=RW
        numerical-value=97, enumerator-value=SA
        numerical-value=98, enumerator-value=SD
        numerical-value=99, enumerator-value=SG
        numerical-value=100, enumerator-value=SH
        numerical-value=101, enumerator-value=SI
        numerical-value=102, enumerator-value=SK
        numerical-value=103, enumerator-value=SL
        numerical-value=104, enumerator-value=SM
        numerical-value=105, enumerator-value=SN
        numerical-value=106, enumerator-value=SO
        numerical-value=107, enumerator-value=SQ
        numerical-value=108, enumerator-value=SR
        numerical-value=109, enumerator-value=SS
        numerical-value=110, enumerator-value=ST
        numerical-value=111, enumerator-value=SU
        numerical-value=112, enumerator-value=SV
        numerical-value=113, enumerator-value=SW
        numerical-value=114, enumerator-value=TA
        numerical-value=115, enumerator-value=TE
        numerical-value=116, enumerator-value=TG
        numerical-value=117, enumerator-value=TH
        numerical-value=118, enumerator-value=TI
        numerical-value=119, enumerator-value=TK
        numerical-value=120, enumerator-value=TL
        numerical-value=121, enumerator-value=TN
        numerical-value=122, enumerator-value=TO
        numerical-value=123, enumerator-value=TR
        numerical-value=124, enumerator-value=TS
        numerical-value=125, enumerator-value=TT
        numerical-value=126, enumerator-value=TW
        numerical-value=127, enumerator-value=UK
        numerical-value=128, enumerator-value=UR
        numerical-value=129, enumerator-value=UZ
        numerical-value=130, enumerator-value=VI
        numerical-value=131, enumerator-value=VO
        numerical-value=132, enumerator-value=WO
        numerical-value=133, enumerator-value=XH
        numerical-value=134, enumerator-value=YO
        numerical-value=135, enumerator-value=ZH
        numerical-value=136, enumerator-value=ZU
    LatencyConstraintTypeEnum: entrys=[{numerical-value=0, enumerator-value=AGE}, {numerical-value=1, enumerator-value=REACTION}]
    LinChecksumType: entrys=[{numerical-value=0, enumerator-value=CLASSIC}, {numerical-value=1, enumerator-value=ENHANCED}]
    ListEnum: entrys=[{numerical-value=0, enumerator-value=NUMBER}, {numerical-value=1, enumerator-value=UNNUMBER}]
    LogTraceDefaultLogLevelEnum
      entrys:
        numerical-value=0, enumerator-value=FATAL
        numerical-value=1, enumerator-value=ERROR
        numerical-value=2, enumerator-value=WARN
        numerical-value=3, enumerator-value=INFO
        numerical-value=4, enumerator-value=DEBUG
        numerical-value=5, enumerator-value=VERBOSE
    LogTraceLogModeEnum
      entrys:
        numerical-value=0, enumerator-value=CONSOLE
        numerical-value=1, enumerator-value=FILE
        numerical-value=2, enumerator-value=NETWORK
    LoggingBehaviorEnum
      entrys:
        numerical-value=0, enumerator-value=DOES-NOT-USE-LOGGING
        numerical-value=1, enumerator-value=USES-LOGGING
    MappingDirectionEnum
      entrys:
        numerical-value=0, enumerator-value=BIDIRECTIONAL
        numerical-value=1, enumerator-value=FIRST-TO-SECOND
        numerical-value=2, enumerator-value=SECOND-TO-FIRST
    MappingScopeEnum
      entrys:
        numerical-value=0, enumerator-value=MAPPING-SCOPE-CORE
        numerical-value=1, enumerator-value=MAPPING-SCOPE-ECU
        numerical-value=2, enumerator-value=MAPPING-SCOPE-PARTITION
    MaxCommModeEnum
      entrys:
        numerical-value=0, enumerator-value=FULL
        numerical-value=1, enumerator-value=NONE
        numerical-value=2, enumerator-value=SILENT
    MaximumMessageLengthType
      entrys:
        numerical-value=0, enumerator-value=I-4-G
        numerical-value=1, enumerator-value=ISO
        numerical-value=2, enumerator-value=ISO-6
    MemoryAllocationKeywordPolicyType
      entrys:
        numerical-value=0, enumerator-value=ADDR-METHOD-SHORT-NAME
        numerical-value=1, enumerator-value=ADDR-METHOD-SHORT-NAME-AND-ALIGNMENT
    MemorySectionType
      entrys:
        numerical-value=0, enumerator-value=CALIBRATION-OFFLINE
        numerical-value=1, enumerator-value=CALIBRATION-ONLINE
        numerical-value=2, enumerator-value=CALIBRATION-VARIABLES
        numerical-value=3, enumerator-value=CALPRM
        numerical-value=4, enumerator-value=CODE
        numerical-value=5, enumerator-value=CONFIG-DATA
        numerical-value=6, enumerator-value=CONST
        numerical-value=7, enumerator-value=EXCLUDE-FROM-FLASH
        numerical-value=8, enumerator-value=USER-DEFINED
        numerical-value=9, enumerator-value=VAR
        numerical-value=10, enumerator-value=VAR-FAST
        numerical-value=11, enumerator-value=VAR-NO-INIT
        numerical-value=12, enumerator-value=VAR-POWER-ON-INIT
    ModeActivationKind
      entrys:
        numerical-value=0, enumerator-value=ON-ENTRY
        numerical-value=1, enumerator-value=ON-EXIT
        numerical-value=2, enumerator-value=ON-TRANSITION
    ModeErrorReactionPolicyEnum: entrys=[{numerical-value=0, enumerator-value=DEFAULT-MODE}, {numerical-value=1, enumerator-value=LAST-MODE}]
    ModificationTypeEnum
      entrys:
        numerical-value=0, enumerator-value=CONTENT-RELATED
        numerical-value=1, enumerator-value=DOC-RELATED
    MonotonyEnum
      entrys:
        numerical-value=0, enumerator-value=DECREASING
        numerical-value=1, enumerator-value=INCREASING
        numerical-value=2, enumerator-value=MONOTONOUS
        numerical-value=3, enumerator-value=NO-MONOTONY
        numerical-value=4, enumerator-value=STRICTLY-DECREASING
        numerical-value=5, enumerator-value=STRICTLY-INCREASING
        numerical-value=6, enumerator-value=STRICT-MONOTONOUS
    NetworkTargetAddressType
      entrys:
        numerical-value=0, enumerator-value=FUNCTIONAL
        numerical-value=1, enumerator-value=FUNCTIONAL-CAN-FD
        numerical-value=2, enumerator-value=PHYSICAL
        numerical-value=3, enumerator-value=PHYSICAL-CAN-FD
    NmCoordinatorRoleEnum: entrys=[{numerical-value=0, enumerator-value=ACTIVE}, {numerical-value=1, enumerator-value=PASSIVE}]
    NoteTypeEnum
      entrys:
        numerical-value=0, enumerator-value=CAUTION
        numerical-value=1, enumerator-value=EXAMPLE
        numerical-value=2, enumerator-value=EXERCISE
        numerical-value=3, enumerator-value=HINT
        numerical-value=4, enumerator-value=INSTRUCTION
        numerical-value=5, enumerator-value=OTHER
        numerical-value=6, enumerator-value=TIP
    NvBlockNeedsReliabilityEnum
      entrys:
        numerical-value=0, enumerator-value=ERROR-CORRECTION
        numerical-value=1, enumerator-value=ERROR-DETECTION
        numerical-value=2, enumerator-value=NO-PROTECTION
    NvBlockNeedsWritingPriorityEnum
      entrys:
        numerical-value=0, enumerator-value=HIGH
        numerical-value=1, enumerator-value=LOW
        numerical-value=2, enumerator-value=MEDIUM
    ObdRatioConnectionKindEnum: entrys=[{numerical-value=0, enumerator-value=API-USE}, {numerical-value=1, enumerator-value=OBSERVER}]
    OperationCycleTypeEnum
      entrys:
        numerical-value=0, enumerator-value=IGNITION
        numerical-value=1, enumerator-value=OBD-DCY
        numerical-value=2, enumerator-value=OTHER
        numerical-value=3, enumerator-value=POWER
        numerical-value=4, enumerator-value=TIME
        numerical-value=5, enumerator-value=WARMUP
    OrientEnum: entrys=[{numerical-value=0, enumerator-value=LAND}, {numerical-value=1, enumerator-value=PORT}]
    PduCollectionSemanticsEnum: entrys=[{numerical-value=0, enumerator-value=LAST-IS-BEST}, {numerical-value=1, enumerator-value=QUEUED}]
    PduCollectionTriggerEnum: entrys=[{numerical-value=0, enumerator-value=ALWAYS}, {numerical-value=1, enumerator-value=NEVER}]
    PersistencyCollectionLevelUpdateStrategyEnum: entrys=[{numerical-value=0, enumerator-value=KEEP-EXISTING}, {numerical-value=1, enumerator-value=DELETE}]
    PersistencyElementLevelUpdateStrategyEnum
      entrys:
        numerical-value=0, enumerator-value=OVERWRITE
        numerical-value=1, enumerator-value=KEEP-EXISTING
        numerical-value=2, enumerator-value=DELETE
    PersistencyRedundancyEnum
      entrys:
        numerical-value=0, enumerator-value=REDUNDANT
        numerical-value=1, enumerator-value=NONE
        numerical-value=2, enumerator-value=REDUNDANT-PER-KEY
    PersistencyRedundancyHandlingScopeEnum
      entrys:
        numerical-value=0, enumerator-value=PERSISTENCY-REDUNDANCY-HANDLING-SCOPE-KEY
        numerical-value=1, enumerator-value=PERSISTENCY-REDUNDANCY-HANDLING-SCOPE-DATABASE
        numerical-value=2, enumerator-value=PERSISTENCY-REDUNDANCY-HANDLING-SCOPE-FILE
    PgwideEnum: entrys=[{numerical-value=0, enumerator-value=NO-PGWIDE}, {numerical-value=1, enumerator-value=PGWIDE}]
    PhmActionListExecutionEnum
      entrys:
        numerical-value=0, enumerator-value=TRIGGERED-ON-CHANGE
        numerical-value=1, enumerator-value=TRIGGERED-ON-EVALUATION
    PhmLogicalOperatorEnum
      entrys:
        numerical-value=0, enumerator-value=AND
        numerical-value=1, enumerator-value=NAND
        numerical-value=2, enumerator-value=NOT
        numerical-value=3, enumerator-value=OR
        numerical-value=4, enumerator-value=XOR
    PhmRuleInitStateEnum
      entrys:
        numerical-value=0, enumerator-value=UNDEFINED
        numerical-value=1, enumerator-value=TRUE
        numerical-value=2, enumerator-value=FALSE
    PlatformPhmActionTypeEnum: entry{numerical-value=0, enumerator-value=RESET-MACHINE}
    PncGatewayTypeEnum
      entrys:
        numerical-value=0, enumerator-value=ACTIVE
        numerical-value=1, enumerator-value=NONE
        numerical-value=2, enumerator-value=PASSIVE
    ProcessPhmActionTypeEnum: entry{numerical-value=0, enumerator-value=RESTART}
    ProcessingKindEnum
      entrys:
        numerical-value=0, enumerator-value=FILTERED
        numerical-value=1, enumerator-value=NONE
        numerical-value=2, enumerator-value=RAW
    ProgramminglanguageEnum
      entrys:
        numerical-value=0, enumerator-value=C
        numerical-value=1, enumerator-value=CPP
        numerical-value=2, enumerator-value=JAVA
    PulseTestEnum: entrys=[{numerical-value=0, enumerator-value=DISABLE}, {numerical-value=1, enumerator-value=ENABLE}]
    RamBlockStatusControlEnum: entrys=[{numerical-value=0, enumerator-value=API}, {numerical-value=1, enumerator-value=NV-RAM-MANAGER}]
    ReceiverCapabilityEnum: entrys=[{numerical-value=0, enumerator-value=WILL-RECEIVE}, {numerical-value=1, enumerator-value=WONT-RECEIVE}]
    ReentrancyLevelEnum
      entrys:
        numerical-value=0, enumerator-value=MULTICORE-REENTRANT
        numerical-value=1, enumerator-value=NON-REENTRANT
        numerical-value=2, enumerator-value=SINGLE-CORE-REENTRANT
    RemotingTechnologyEnum: entrys=[{numerical-value=0, enumerator-value=AR--CLIENT--SERVER}, {numerical-value=1, enumerator-value=SOMEIP}]
    ReportBehaviorEnum
      entrys:
        numerical-value=0, enumerator-value=REPORT-AFTER-INIT
        numerical-value=1, enumerator-value=REPORT-BEFORE-INIT
    RequestMethodEnum
      entrys:
        numerical-value=0, enumerator-value=CONNECT
        numerical-value=1, enumerator-value=DELETE
        numerical-value=2, enumerator-value=GET
        numerical-value=3, enumerator-value=HEAD
        numerical-value=4, enumerator-value=OPTIONS
        numerical-value=5, enumerator-value=POST
        numerical-value=6, enumerator-value=PUT
        numerical-value=7, enumerator-value=TRACE
    RequestTypeEnum: entrys=[{numerical-value=0, enumerator-value=PHYSICAL}, {numerical-value=1, enumerator-value=FUNCTIONAL}]
    ResolutionPolicyEnum: entrys=[{numerical-value=0, enumerator-value=NO-SLOPPY}, {numerical-value=1, enumerator-value=SLOPPY}]
    ResumePosition
      entrys:
        numerical-value=0, enumerator-value=CONTINUE-AT-IT-POSITION
        numerical-value=1, enumerator-value=START-FROM-BEGINNING
    RptAccessEnum
      entrys:
        numerical-value=0, enumerator-value=ENABLED
        numerical-value=1, enumerator-value=NONE
        numerical-value=2, enumerator-value=PROTECTED
    RptEnablerImplTypeEnum
      entrys:
        numerical-value=0, enumerator-value=NONE
        numerical-value=1, enumerator-value=RPT-ENABLER-RAM
        numerical-value=2, enumerator-value=RPT-ENABLER-ROM
        numerical-value=3, enumerator-value=RPT-ENABLER-RAM-AND-ROM
    RptExecutionControlEnum: entrys=[{numerical-value=0, enumerator-value=CONDITIONAL}, {numerical-value=1, enumerator-value=NONE}]
    RptPreparationEnum
      entrys:
        numerical-value=0, enumerator-value=NONE
        numerical-value={1..3}, enumerator-value=RPT-LEVEL-{1..3}
    RptServicePointEnum: entrys=[{numerical-value=0, enumerator-value=ENABLED}, {numerical-value=1, enumerator-value=NONE}]
    RunMode: entrys=[{numerical-value=0, enumerator-value=RUN-CONTINUOUS}, {numerical-value=1, enumerator-value=RUN-ONCE}]
    RuntimeAddressConfigurationEnum: entrys=[{numerical-value=0, enumerator-value=NONE}, {numerical-value=1, enumerator-value=SD}]
    RxAcceptContainedIPduEnum
      entrys:
        numerical-value=0, enumerator-value=ACCEPT-ALL
        numerical-value=1, enumerator-value=ACCEPT-CONFIGURED
    SOMEIPMessageTypeEnum
      entrys:
        numerical-value=0, enumerator-value=ERROR
        numerical-value=1, enumerator-value=NOTIFICATION
        numerical-value=2, enumerator-value=REQUEST
        numerical-value=3, enumerator-value=REQUEST-NO-RETURN
        numerical-value=4, enumerator-value=RESPONSE
    SOMEIPTransformerSessionHandlingEnum
      entrys:
        numerical-value=0, enumerator-value=SESSION-HANDLING-ACTIVE
        numerical-value=1, enumerator-value=SESSION-HANDLING-INACTIVE
    ScaleConstrValidityEnum
      entrys:
        numerical-value=0, enumerator-value=NOT-AVAILABLE
        numerical-value=1, enumerator-value=NOT-DEFINED
        numerical-value=2, enumerator-value=NOT-VALID
        numerical-value=3, enumerator-value=VALID
    SchedulingPolicyKindEnum
      entrys:
        numerical-value=0, enumerator-value=SCHEDULING-POLICY-FIFO
        numerical-value=1, enumerator-value=SCHEDULING-POLICY-ROUND-ROBIN
        numerical-value=2, enumerator-value=SCHEDULING-POLICY-OTHER
    SearchIntentionEnum
      entrys:
        numerical-value=0, enumerator-value=SEARCH-FOR-ALL
        numerical-value=1, enumerator-value=SEARCH-FOR-ID
    SecOcJobSemanticEnum: entrys=[{numerical-value=0, enumerator-value=AUTHENTICATE}, {numerical-value=1, enumerator-value=VERIFY}]
    SecuredPduHeaderEnum
      entrys:
        numerical-value=0, enumerator-value=NO-HEADER
        numerical-value=1, enumerator-value=SECURED-PDU-HEADER-08-BIT
        numerical-value=2, enumerator-value=SECURED-PDU-HEADER-16-BIT
        numerical-value=3, enumerator-value=SECURED-PDU-HEADER-32-BIT
    SenderCapabilityEnum: entrys=[{numerical-value=0, enumerator-value=WILL-SEND}, {numerical-value=1, enumerator-value=WONT-SEND}]
    SerializationTechnologyEnum: entrys=[{numerical-value=0, enumerator-value=SOMEIP}, {numerical-value=1, enumerator-value=SIGNAL-BASED}]
    ServerArgumentImplPolicyEnum
      entrys:
        numerical-value=0, enumerator-value=USE-ARGUMENT-TYPE
        numerical-value=1, enumerator-value=USE-ARRAY-BASE-TYPE
        numerical-value=2, enumerator-value=USE-VOID
    ServiceProviderEnum
      entrys:
        numerical-value=0, enumerator-value=ANY-STANDARDIZED
        numerical-value=1, enumerator-value=BASIC-SOFTWARE-MODE-MANAGER
        numerical-value=2, enumerator-value=COM-MANAGER
        numerical-value=3, enumerator-value=CRYPTO-SERVICE-MANAGER
        numerical-value=4, enumerator-value=DEFAULT-ERROR-TRACER
        numerical-value=5, enumerator-value=DEVELOPMENT-ERROR-TRACER
        numerical-value=6, enumerator-value=DIAGNOSTIC-COMMUNICATION-MANAGER
        numerical-value=7, enumerator-value=DIAGNOSTIC-EVENT-MANAGER
        numerical-value=8, enumerator-value=DIAGNOSTIC-LOG-AND-TRACE
        numerical-value=9, enumerator-value=ECU-MANAGER
        numerical-value=10, enumerator-value=FUNCTION-INHIBITION-MANAGER
        numerical-value=11, enumerator-value=J-1939-REQUEST-MANAGER
        numerical-value=12, enumerator-value=NON-VOLATILE-RAM-MANAGER
        numerical-value=13, enumerator-value=OPERATING-SYSTEM
        numerical-value=14, enumerator-value=SECURE-ON-BOARD-COMMUNICATION
        numerical-value=15, enumerator-value=SYNC-BASE-TIME-MANAGER
        numerical-value=16, enumerator-value=VENDOR-SPECIFIC
        numerical-value=17, enumerator-value=WATCH-DOG-MANAGER
    ServiceVersionAcceptanceKindEnum
      entrys:
        numerical-value=0, enumerator-value=EXACT-OR-ANY-MINOR-VERSION
        numerical-value=1, enumerator-value=MINIMUM-MINOR-VERSION
    SeverityEnum
      entrys:
        numerical-value=0, enumerator-value=INFO
        numerical-value=1, enumerator-value=WARNING
        numerical-value=2, enumerator-value=ERROR
    ShowContentEnum
      entrys:
        numerical-value=0, enumerator-value=NO-SHOW-CONTENT
        numerical-value=1, enumerator-value=SHOW-CONTENT
    ShowResourceAliasNameEnum
      entrys:
        numerical-value=0, enumerator-value=NO-SHOW-ALIAS-NAME
        numerical-value=1, enumerator-value=SHOW-ALIAS-NAME
    ShowResourceCategoryEnum
      entrys:
        numerical-value=0, enumerator-value=NO-SHOW-CATEGORY
        numerical-value=1, enumerator-value=SHOW-CATEGORY
    ShowResourceLongNameEnum
      entrys:
        numerical-value=0, enumerator-value=NO-SHOW-LONG-NAME
        numerical-value=1, enumerator-value=SHOW-LONG-NAME
    ShowResourceNumberEnum
      entrys:
        numerical-value=0, enumerator-value=NO-SHOW-NUMBER
        numerical-value=1, enumerator-value=SHOW-NUMBER
    ShowResourcePageEnum: entrys=[{numerical-value=0, enumerator-value=NO-SHOW-PAGE}, {numerical-value=1, enumerator-value=SHOW-PAGE}]
    ShowResourceShortNameEnum
      entrys:
        numerical-value=0, enumerator-value=NO-SHOW-SHORT-NAME
        numerical-value=1, enumerator-value=SHOW-SHORT-NAME
    ShowResourceTypeEnum: entrys=[{numerical-value=0, enumerator-value=NO-SHOW-TYPE}, {numerical-value=1, enumerator-value=SHOW-TYPE}]
    ShowSeeEnum: entrys=[{numerical-value=0, enumerator-value=NO-SHOW-SEE}, {numerical-value=1, enumerator-value=SHOW-SEE}]
    SignalFanEnum: entrys=[{numerical-value=0, enumerator-value=NFOLD}, {numerical-value=1, enumerator-value=SINGLE}]
    SignalServiceTranslationControlEnum
      entrys:
        numerical-value=0, enumerator-value=TRANSLATION-START
        numerical-value=1, enumerator-value=PARTIAL-NETWORK
        numerical-value=2, enumerator-value=SERVICE-DISCOVERY
    SoAdConnectorType
      entrys:
        numerical-value=0, enumerator-value=DO-IP
        numerical-value=1, enumerator-value=PDU-R
        numerical-value=2, enumerator-value=UDP-NM
        numerical-value=3, enumerator-value=XCP
    SoAdProtocolType: entrys=[{numerical-value=0, enumerator-value=TCP}, {numerical-value=1, enumerator-value=UDP}]
    SoftwareActivationDependencyLogicalOperatorEnum: entrys=[{numerical-value=0, enumerator-value=LOGICAL-AND}, {numerical-value=1, enumerator-value=LOGICAL-OR}]
    SoftwareActivationDependencyOperatorEnum
      entrys:
        numerical-value=0, enumerator-value=IS-GREATER-THAN
        numerical-value=1, enumerator-value=IS-EQUAL
        numerical-value=2, enumerator-value=IS-LESS-THAN
        numerical-value=3, enumerator-value=IS-GREATER-THAN-OR-EQUAL
        numerical-value=4, enumerator-value=IS-LESS-THAN-OR-EQUAL
    SoftwareClusterDiagnosticAddressSemanticsEnum
      entrys:
        numerical-value=0, enumerator-value=PHYSICAL-ADDRESS
        numerical-value=1, enumerator-value=FUNCTIONAL-ADDRESS
    SoftwarePackageActionTypeEnum
      entrys:
        numerical-value=0, enumerator-value=UPDATE
        numerical-value=1, enumerator-value=INSTALL
        numerical-value=2, enumerator-value=REMOVE
    SoftwarePackageActivationActionEnum
      entrys:
        numerical-value=0, enumerator-value=REBOOT
        numerical-value=1, enumerator-value=RESTART-APPLICATION
        numerical-value=2, enumerator-value=NOTHING
    SoftwarePackageStoringEnum
      entrys:
        numerical-value=0, enumerator-value=NONE
        numerical-value=1, enumerator-value=UCM-MASTER
        numerical-value=2, enumerator-value=UCM
    StorageConditionStatusEnum
      entrys:
        numerical-value=0, enumerator-value=EVENT-STORAGE-DISABLED
        numerical-value=1, enumerator-value=EVENT-STORAGE-ENABLED
    SupportBufferLockingEnum
      entrys:
        numerical-value=0, enumerator-value=DOES-NOT-SUPPORT-BUFFER-LOCKING
        numerical-value=1, enumerator-value=SUPPORTS-BUFFER-LOCKING
    SwCalibrationAccessEnum
      entrys:
        numerical-value=0, enumerator-value=NOT-ACCESSIBLE
        numerical-value=1, enumerator-value=READ-ONLY
        numerical-value=2, enumerator-value=READ-WRITE
    SwImplPolicyEnum
      entrys:
        numerical-value=0, enumerator-value=CONST
        numerical-value=1, enumerator-value=FIXED
        numerical-value=2, enumerator-value=MEASUREMENT-POINT
        numerical-value=3, enumerator-value=QUEUED
        numerical-value=4, enumerator-value=STANDARD
    SwServiceImplPolicyEnum
      entrys:
        numerical-value=0, enumerator-value=INLINE
        numerical-value=1, enumerator-value=INLINE-CONDITIONAL
        numerical-value=2, enumerator-value=MACRO
        numerical-value=3, enumerator-value=STANDARD
    SwServiceReentranceEnum: entry{numerical-value=0, enumerator-value=REENTRANCE}
    SwVariableAccessImplPolicyEnum
      entrys:
        numerical-value=0, enumerator-value=DIRECT
        numerical-value=1, enumerator-value=OPTIMIZED
        numerical-value=2, enumerator-value=SELECTABLE
    SwcToEcuMappingConstraintType: entrys=[{numerical-value=0, enumerator-value=DEDICATED}, {numerical-value=1, enumerator-value=EXCLUSIVE}]
    SwcToSwcOperationArgumentsDirectionEnum: entrys=[{numerical-value=0, enumerator-value=IN}, {numerical-value=1, enumerator-value=OUT}]
    SynchronizationTypeEnum
      entrys:
        numerical-value=0, enumerator-value=RESPONSE-SYNCHRONIZATION
        numerical-value=1, enumerator-value=STIMULUS-SYNCHRONIZATION
    TDEventBswInternalBehaviorTypeEnum
      entrys:
        numerical-value=0, enumerator-value=BSW-MODULE-ENTITY-ACTIVATED
        numerical-value=1, enumerator-value=BSW-MODULE-ENTITY-STARTED
        numerical-value=2, enumerator-value=BSW-MODULE-ENTITY-TERMINATED
    TDEventBswModeDeclarationTypeEnum
      entrys:
        numerical-value=0, enumerator-value=MODE-DECLARATION-REQUESTED
        numerical-value=1, enumerator-value=MODE-DECLARATION-SWITCH-COMPLETED
        numerical-value=2, enumerator-value=MODE-DECLARATION-SWITCH-INITIATED
    TDEventBswModuleTypeEnum
      entrys:
        numerical-value=0, enumerator-value=BSW-M-ENTRY-CALLED
        numerical-value=1, enumerator-value=BSW-M-ENTRY-CALL-RETURNED
    TDEventFrameEthernetTypeEnum
      entrys:
        numerical-value=0, enumerator-value=FRAME-ETHERNET-QUEUED-FOR-TRANSMISSION
        numerical-value=1, enumerator-value=FRAME-ETHERNET-RECEIVED-BY-IF
        numerical-value=2, enumerator-value=FRAME-ETHERNET-RECEIVED-ON-BUS
        numerical-value=3, enumerator-value=FRAME-ETHERNET-SENT-ON-BUS
    TDEventFrameTypeEnum
      entrys:
        numerical-value=0, enumerator-value=FRAME-QUEUED-FOR-TRANSMISSION
        numerical-value=1, enumerator-value=FRAME-RECEIVED-BY-IF
        numerical-value=2, enumerator-value=FRAME-TRANSMITTED-ON-BUS
    TDEventIPduTypeEnum
      entrys:
        numerical-value=0, enumerator-value=I-PDU-RECEIVED-BY-COM
        numerical-value=1, enumerator-value=I-PDU-SENT-TO-IF
    TDEventISignalTypeEnum
      entrys:
        numerical-value=0, enumerator-value=I-SIGNAL-AVAILABLE-FOR-RTE
        numerical-value=1, enumerator-value=I-SIGNAL-SENT-TO-COM
    TDEventModeDeclarationTypeEnum
      entrys:
        numerical-value=0, enumerator-value=MODE-DECLARATION-SWITCH-COMPLETED
        numerical-value=1, enumerator-value=MODE-DECLARATION-SWITCH-INITIATED
    TDEventOperationTypeEnum
      entrys:
        numerical-value=0, enumerator-value=OPERATION-CALLED
        numerical-value=1, enumerator-value=OPERATION-CALL-RECEIVED
        numerical-value=2, enumerator-value=OPERATION-CALL-RESPONSE-RECEIVED
        numerical-value=3, enumerator-value=OPERATION-CALL-RESPONSE-SENT
    TDEventSwcInternalBehaviorTypeEnum
      entrys:
        numerical-value=0, enumerator-value=RUNNABLE-ENTITY-ACTIVATED
        numerical-value=1, enumerator-value=RUNNABLE-ENTITY-STARTED
        numerical-value=2, enumerator-value=RUNNABLE-ENTITY-TERMINATED
        numerical-value=3, enumerator-value=RUNNABLE-ENTITY-VARIABLE-ACCESS
    TDEventTriggerTypeEnum
      entrys:
        numerical-value=0, enumerator-value=TRIGGER-ACTIVATED
        numerical-value=1, enumerator-value=TRIGGER-RELEASED
    TDEventVariableDataPrototypeTypeEnum
      entrys:
        numerical-value=0, enumerator-value=VARIABLE-DATA-PROTOTYPE-RECEIVED
        numerical-value=1, enumerator-value=VARIABLE-DATA-PROTOTYPE-SENT
    TcpRoleEnum: entrys=[{numerical-value=0, enumerator-value=CONNECT}, {numerical-value=1, enumerator-value=LISTEN}]
    TimeSyncTechnologyEnum
      entrys:
        numerical-value=0, enumerator-value=AVB--IEEE-802--1-AS
        numerical-value=1, enumerator-value=NTP--RFC-958
        numerical-value=2, enumerator-value=PTP--IEEE-1588--2002
        numerical-value=3, enumerator-value=PTP--IEEE-1588--2008
    TimeSynchronizationKindEnum: entrys=[{numerical-value=0, enumerator-value=SYNCHRONIZED}, {numerical-value=1, enumerator-value=OFFSET}]
    TlsVersionEnum
      entrys:
        numerical-value=0, enumerator-value=TLS-12
        numerical-value=1, enumerator-value=LTS-13
        numerical-value=2, enumerator-value=TLS-13
    TpAckType: entrys=[{numerical-value=0, enumerator-value=ACK-WITH-RT}, {numerical-value=1, enumerator-value=NO-ACK}]
    TransferPropertyEnum
      entrys:
        numerical-value=0, enumerator-value=PENDING
        numerical-value=1, enumerator-value=TRIGGERED
        numerical-value=2, enumerator-value=TRIGGERED-ON-CHANGE
        numerical-value=3, enumerator-value=TRIGGERED-ON-CHANGE-WITHOUT-REPETITION
        numerical-value=4, enumerator-value=TRIGGERED-WITHOUT-REPETITION
    TransformerClassEnum
      entrys:
        numerical-value=0, enumerator-value=CUSTOM
        numerical-value=1, enumerator-value=SAFETY
        numerical-value=2, enumerator-value=SECURITY
        numerical-value=3, enumerator-value=SERIALIZER
    TransportLayerProtocolEnum: entrys=[{numerical-value=0, enumerator-value=UDP}, {numerical-value=1, enumerator-value=TCP}]
    TriggerMode
      entrys:
        numerical-value=0, enumerator-value=DYNAMIC-PART-TRIGGER
        numerical-value=1, enumerator-value=NONE
        numerical-value=2, enumerator-value=STATIC-OR-DYNAMIC-PART-TRIGGER
        numerical-value=3, enumerator-value=STATIC-PART-TRIGGER
    TrustedPlatformExecutableLaunchBehaviorEnum
      entrys:
        numerical-value=0, enumerator-value=STRICT-MODE
        numerical-value=1, enumerator-value=MONITOR-MODE
        numerical-value=2, enumerator-value=NO-TRUSTED-PLATFORM-SUPPORT
    TtcanTriggerType
      entrys:
        numerical-value=0, enumerator-value=RX-TRIGGER
        numerical-value=1, enumerator-value=TX-REF-TRIGGER
        numerical-value=2, enumerator-value=TX-REF-TRIGGER-GAP
        numerical-value=3, enumerator-value=TX-TRIGGER-MERGED
        numerical-value=4, enumerator-value=TX-TRIGGER-SINGLE
        numerical-value=5, enumerator-value=WATCH-TRIGGER
        numerical-value=6, enumerator-value=WATCH-TRIGGER-GAP
    UdpChecksumCalculationEnum
      entrys:
        numerical-value=0, enumerator-value=UDP-CHECKSUM-ENABLED
        numerical-value=1, enumerator-value=UDP-CHECKSUM-DISABLED
    UdpCollectionTriggerEnum: entrys=[{numerical-value=0, enumerator-value=ALWAYS}, {numerical-value=1, enumerator-value=NEVER}]
    V2xSupportEnum
      entrys:
        numerical-value=0, enumerator-value=V-2-X-ACTIVE-SUPPORTED
        numerical-value=1, enumerator-value=V-2-X-NOT-SUPPORTED
    ValignEnum
      entrys:
        numerical-value=0, enumerator-value=BOTTOM
        numerical-value=1, enumerator-value=MIDDLE
        numerical-value=2, enumerator-value=TOP
    VariableAccessScopeEnum
      entrys:
        numerical-value=0, enumerator-value=COMMUNICATION-INTER-ECU
        numerical-value=1, enumerator-value=COMMUNICATION-INTRA-PARTITION
        numerical-value=2, enumerator-value=INTER-PARTITION-INTRA-ECU
    VehicleDriverNotificationEnum
      entrys:
        numerical-value=0, enumerator-value=TRANSFER
        numerical-value=1, enumerator-value=PROCESS
        numerical-value=2, enumerator-value=ACTIVATE
        numerical-value=3, enumerator-value=ROLL-BACK
        numerical-value=4, enumerator-value=FINISH
    WatchdogPhmActionTypeEnum
      entrys:
        numerical-value=0, enumerator-value=STOP-TRIGGER
        numerical-value=1, enumerator-value=WRONG-TRIGGER
    XmlSpaceEnum: entrys=[{numerical-value=0, enumerator-value=default}, {numerical-value=1, enumerator-value=preserve}]
    standardNameEnum
      entrys:
        numerical-value=0, enumerator-value=AP
        numerical-value=1, enumerator-value=CP
        numerical-value=2, enumerator-value=FO
        numerical-value=3, enumerator-value=TA
        numerical-value=4, enumerator-value=TC
